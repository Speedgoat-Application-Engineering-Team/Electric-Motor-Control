/******************************************************************************
* ASAP2 file: FieldOrientedController_HIL.a2l
* Prerelease License - for engineering feedback and testing purposes
* only. Not for sale.
* Code generation for model "FieldOrientedController_HIL".
* Model version : 2.17
* Simulink Coder version : 10.2 R2020b
* C source code generated on : Wed Mar 03 11:57:31 2021
* Target selection: slrealtime.tlc
* Embedded hardware selection: Intel->x86-64 (Linux 64)
* Code generation objectives: Unspecified
* Validation result: Not run
* (add additional file header information here)
******************************************************************************/ ASAP2_VERSION 1 71
/begin PROJECT ProjectName "Project Comment Goes Here"
/begin HEADER "Header Comments go here" /end HEADER
/begin MODULE ModuleName "Module Comment Goes Here"
/begin IF_DATA XCP
 /begin PROTOCOL_LAYER 0x0100 0x03E8 0x00C8 0x0000 0x0000 0x0000 0x0000 0x0000 0xFC 0x0578 BYTE_ORDER_MSB_LAST ADDRESS_GRANULARITY_BYTE OPTIONAL_CMD ALLOC_ODT_ENTRY OPTIONAL_CMD ALLOC_ODT OPTIONAL_CMD ALLOC_DAQ OPTIONAL_CMD FREE_DAQ OPTIONAL_CMD GET_DAQ_RESOLUTION_INFO OPTIONAL_CMD GET_DAQ_PROCESSOR_INFO OPTIONAL_CMD START_STOP_SYNCH OPTIONAL_CMD START_STOP_DAQ_LIST OPTIONAL_CMD SET_DAQ_LIST_MODE OPTIONAL_CMD WRITE_DAQ OPTIONAL_CMD SET_DAQ_PTR OPTIONAL_CMD GET_CAL_PAGE OPTIONAL_CMD SET_CAL_PAGE OPTIONAL_CMD COPY_CAL_PAGE OPTIONAL_CMD SHORT_DOWNLOAD OPTIONAL_CMD DOWNLOAD_MAX OPTIONAL_CMD DOWNLOAD OPTIONAL_CMD SHORT_UPLOAD OPTIONAL_CMD UPLOAD OPTIONAL_CMD SET_MTA /end PROTOCOL_LAYER
 /begin DAQ DYNAMIC 0x0000 0x0080 0x00 OPTIMISATION_TYPE_DEFAULT ADDRESS_EXTENSION_FREE IDENTIFICATION_FIELD_TYPE_RELATIVE_WORD_ALIGNED GRANULARITY_ODT_ENTRY_SIZE_DAQ_BYTE 0xFF OVERLOAD_INDICATION_PID PRESCALER_SUPPORTED /begin STIM GRANULARITY_ODT_ENTRY_SIZE_STIM_BYTE 0xFF /end STIM /begin TIMESTAMP_SUPPORTED 0x0001 SIZE_DWORD UNIT_1US TIMESTAMP_FIXED /end TIMESTAMP_SUPPORTED /begin EVENT "250 us" "250 us" 0x0000 DAQ 0xFF 0x19 0x04 0x00 /end EVENT /end DAQ
 /begin XCP_ON_UDP_IP 0x0100 0x15B3 ADDRESS "172.16.19.52" /end XCP_ON_UDP_IP
/end IF_DATA
/begin MOD_PAR "MOD PAR Comment Goes Here"
 /begin MEMORY_SEGMENT FieldOrientedController_HIL_cal_impl "FieldOrientedController_HIL_cal_impl" DATA FLASH INTERN 0x002C0060 0x6E0 -1 -1 -1 -1 -1
  /begin IF_DATA XCP
   /begin SEGMENT 0x00 0x02 0x00 0x00 0x00
    /begin PAGE 0x00 ECU_ACCESS_DONT_CARE XCP_READ_ACCESS_DONT_CARE XCP_WRITE_ACCESS_NOT_ALLOWED /end PAGE
    /begin PAGE 0x01 ECU_ACCESS_DONT_CARE XCP_READ_ACCESS_DONT_CARE XCP_WRITE_ACCESS_DONT_CARE /end PAGE
   /end SEGMENT
  /end IF_DATA
 /end MEMORY_SEGMENT
 /begin MEMORY_SEGMENT PMSM_Plant_Model_cal_impl "PMSM_Plant_Model_cal_impl" DATA FLASH INTERN 0x002C09A0 0x50 -1 -1 -1 -1 -1
  /begin IF_DATA XCP
   /begin SEGMENT 0x01 0x02 0x00 0x00 0x00
    /begin PAGE 0x00 ECU_ACCESS_DONT_CARE XCP_READ_ACCESS_DONT_CARE XCP_WRITE_ACCESS_NOT_ALLOWED /end PAGE
    /begin PAGE 0x01 ECU_ACCESS_DONT_CARE XCP_READ_ACCESS_DONT_CARE XCP_WRITE_ACCESS_DONT_CARE /end PAGE
   /end SEGMENT
  /end IF_DATA
 /end MEMORY_SEGMENT
/end MOD_PAR
/begin MOD_COMMON "Mod Common Comment Here" BYTE_ORDER MSB_LAST /end MOD_COMMON
/begin CHARACTERISTIC FieldOrientedController_HIL_cal_impl.ADCPhaseCurrentCount_P1 "" VALUE 0x002C0398 Scalar_FLOAT64_IEEE 0 FieldOrientedController_HIL_CM_double -1.7E+308 1.7E+308 /end CHARACTERISTIC
/begin CHARACTERISTIC FieldOrientedController_HIL_cal_impl.ADCPhaseCurrentCount_P2 "" VALUE 0x002C03B0 Scalar_FLOAT64_IEEE 0 FieldOrientedController_HIL_CM_double -1.7E+308 1.7E+308 /end CHARACTERISTIC
/begin CHARACTERISTIC FieldOrientedController_HIL_cal_impl.ADCPhaseCurrentCount_P3 "" VAL_BLK 0x002C03C8 Scalar_FLOAT64_IEEE 0 FieldOrientedController_HIL_CM_double -1.7E+308 1.7E+308 MATRIX_DIM 2 1 /end CHARACTERISTIC
/begin CHARACTERISTIC FieldOrientedController_HIL_cal_impl.ADCPhaseCurrentCount_P4 "" VAL_BLK 0x002C03E8 Scalar_FLOAT64_IEEE 0 FieldOrientedController_HIL_CM_double -1.7E+308 1.7E+308 MATRIX_DIM 2 1 /end CHARACTERISTIC
/begin CHARACTERISTIC FieldOrientedController_HIL_cal_impl.ADCPhaseCurrentCount_P5 "" VAL_BLK 0x002C0408 Scalar_FLOAT64_IEEE 0 FieldOrientedController_HIL_CM_double -1.7E+308 1.7E+308 MATRIX_DIM 2 1 /end CHARACTERISTIC
/begin CHARACTERISTIC FieldOrientedController_HIL_cal_impl.ADCPhaseCurrentCount_P6 "" VALUE 0x002C0428 Scalar_FLOAT64_IEEE 0 FieldOrientedController_HIL_CM_double -1.7E+308 1.7E+308 /end CHARACTERISTIC
/begin CHARACTERISTIC FieldOrientedController_HIL_cal_impl.ADCPhaseCurrentCount_P7 "" VALUE 0x002C0440 Scalar_FLOAT64_IEEE 0 FieldOrientedController_HIL_CM_double -1.7E+308 1.7E+308 /end CHARACTERISTIC
/begin CHARACTERISTIC FieldOrientedController_HIL_cal_impl.ADCPhaseCurrentCount_P8 "" VALUE 0x002C0458 Scalar_FLOAT64_IEEE 0 FieldOrientedController_HIL_CM_double -1.7E+308 1.7E+308 /end CHARACTERISTIC
/begin CHARACTERISTIC FieldOrientedController_HIL_cal_impl.CoSInterrupt2_P1 "" VALUE 0x002C05C0 Scalar_FLOAT64_IEEE 0 FieldOrientedController_HIL_CM_double -1.7E+308 1.7E+308 /end CHARACTERISTIC
/begin CHARACTERISTIC FieldOrientedController_HIL_cal_impl.CoSInterrupt2_P10 "" VALUE 0x002C0698 Scalar_FLOAT64_IEEE 0 FieldOrientedController_HIL_CM_double -1.7E+308 1.7E+308 /end CHARACTERISTIC
/begin CHARACTERISTIC FieldOrientedController_HIL_cal_impl.CoSInterrupt2_P11 "" VALUE 0x002C06B0 Scalar_FLOAT64_IEEE 0 FieldOrientedController_HIL_CM_double -1.7E+308 1.7E+308 /end CHARACTERISTIC
/begin CHARACTERISTIC FieldOrientedController_HIL_cal_impl.CoSInterrupt2_P12 "" VALUE 0x002C06C8 Scalar_FLOAT64_IEEE 0 FieldOrientedController_HIL_CM_double -1.7E+308 1.7E+308 /end CHARACTERISTIC
/begin CHARACTERISTIC FieldOrientedController_HIL_cal_impl.CoSInterrupt2_P13 "" VALUE 0x002C06E0 Scalar_FLOAT64_IEEE 0 FieldOrientedController_HIL_CM_double -1.7E+308 1.7E+308 /end CHARACTERISTIC
/begin CHARACTERISTIC FieldOrientedController_HIL_cal_impl.CoSInterrupt2_P14 "" VALUE 0x002C06F8 Scalar_FLOAT64_IEEE 0 FieldOrientedController_HIL_CM_double -1.7E+308 1.7E+308 /end CHARACTERISTIC
/begin CHARACTERISTIC FieldOrientedController_HIL_cal_impl.CoSInterrupt2_P15 "" VALUE 0x002C0710 Scalar_FLOAT64_IEEE 0 FieldOrientedController_HIL_CM_double -1.7E+308 1.7E+308 /end CHARACTERISTIC
/begin CHARACTERISTIC FieldOrientedController_HIL_cal_impl.CoSInterrupt2_P16 "" VALUE 0x002C0728 Scalar_FLOAT64_IEEE 0 FieldOrientedController_HIL_CM_double -1.7E+308 1.7E+308 /end CHARACTERISTIC
/begin CHARACTERISTIC FieldOrientedController_HIL_cal_impl.CoSInterrupt2_P2 "" VALUE 0x002C05D8 Scalar_FLOAT64_IEEE 0 FieldOrientedController_HIL_CM_double -1.7E+308 1.7E+308 /end CHARACTERISTIC
/begin CHARACTERISTIC FieldOrientedController_HIL_cal_impl.CoSInterrupt2_P3 "" VALUE 0x002C05F0 Scalar_FLOAT64_IEEE 0 FieldOrientedController_HIL_CM_double -1.7E+308 1.7E+308 /end CHARACTERISTIC
/begin CHARACTERISTIC FieldOrientedController_HIL_cal_impl.CoSInterrupt2_P4 "" VALUE 0x002C0608 Scalar_FLOAT64_IEEE 0 FieldOrientedController_HIL_CM_double -1.7E+308 1.7E+308 /end CHARACTERISTIC
/begin CHARACTERISTIC FieldOrientedController_HIL_cal_impl.CoSInterrupt2_P5 "" VALUE 0x002C0620 Scalar_FLOAT64_IEEE 0 FieldOrientedController_HIL_CM_double -1.7E+308 1.7E+308 /end CHARACTERISTIC
/begin CHARACTERISTIC FieldOrientedController_HIL_cal_impl.CoSInterrupt2_P6 "" VALUE 0x002C0638 Scalar_FLOAT64_IEEE 0 FieldOrientedController_HIL_CM_double -1.7E+308 1.7E+308 /end CHARACTERISTIC
/begin CHARACTERISTIC FieldOrientedController_HIL_cal_impl.CoSInterrupt2_P7 "" VALUE 0x002C0650 Scalar_FLOAT64_IEEE 0 FieldOrientedController_HIL_CM_double -1.7E+308 1.7E+308 /end CHARACTERISTIC
/begin CHARACTERISTIC FieldOrientedController_HIL_cal_impl.CoSInterrupt2_P8 "" VALUE 0x002C0668 Scalar_FLOAT64_IEEE 0 FieldOrientedController_HIL_CM_double -1.7E+308 1.7E+308 /end CHARACTERISTIC
/begin CHARACTERISTIC FieldOrientedController_HIL_cal_impl.CoSInterrupt2_P9 "" VALUE 0x002C0680 Scalar_FLOAT64_IEEE 0 FieldOrientedController_HIL_CM_double -1.7E+308 1.7E+308 /end CHARACTERISTIC
/begin CHARACTERISTIC FieldOrientedController_HIL_cal_impl.CommandType_Value "" VALUE 0x002C0737 Scalar_UBYTE 0 FieldOrientedController_HIL_CM_uint8 0 255 /end CHARACTERISTIC
/begin CHARACTERISTIC FieldOrientedController_HIL_cal_impl.ConnectCurrentSensor_Value "" VALUE 0x002C0734 Scalar_BOOLEAN 0 FieldOrientedController_HIL_CM_logical 0 1 /end CHARACTERISTIC
/begin CHARACTERISTIC FieldOrientedController_HIL_cal_impl.Digitalinput_P1 "" VALUE 0x002C0080 Scalar_FLOAT64_IEEE 0 FieldOrientedController_HIL_CM_double -1.7E+308 1.7E+308 /end CHARACTERISTIC
/begin CHARACTERISTIC FieldOrientedController_HIL_cal_impl.Digitalinput_P2 "" VALUE 0x002C0098 Scalar_FLOAT64_IEEE 0 FieldOrientedController_HIL_CM_double -1.7E+308 1.7E+308 /end CHARACTERISTIC
/begin CHARACTERISTIC FieldOrientedController_HIL_cal_impl.Digitalinput_P3 "" VALUE 0x002C00B0 Scalar_FLOAT64_IEEE 0 FieldOrientedController_HIL_CM_double -1.7E+308 1.7E+308 /end CHARACTERISTIC
/begin CHARACTERISTIC FieldOrientedController_HIL_cal_impl.Digitalinput_P4 "" VALUE 0x002C00C8 Scalar_FLOAT64_IEEE 0 FieldOrientedController_HIL_CM_double -1.7E+308 1.7E+308 /end CHARACTERISTIC
/begin CHARACTERISTIC FieldOrientedController_HIL_cal_impl.Digitalinput_P5 "" VALUE 0x002C00E0 Scalar_FLOAT64_IEEE 0 FieldOrientedController_HIL_CM_double -1.7E+308 1.7E+308 /end CHARACTERISTIC
/begin CHARACTERISTIC FieldOrientedController_HIL_cal_impl.Digitalinput_P6 "" VALUE 0x002C00F8 Scalar_FLOAT64_IEEE 0 FieldOrientedController_HIL_CM_double -1.7E+308 1.7E+308 /end CHARACTERISTIC
/begin CHARACTERISTIC FieldOrientedController_HIL_cal_impl.EngageMotorBrake_Value "" VALUE 0x002C0735 Scalar_BOOLEAN 0 FieldOrientedController_HIL_CM_logical 0 1 /end CHARACTERISTIC
/begin CHARACTERISTIC FieldOrientedController_HIL_cal_impl.MotorStatus_Value "" VALUE 0x002C0736 Scalar_BOOLEAN 0 FieldOrientedController_HIL_CM_logical 0 1 /end CHARACTERISTIC
/begin CHARACTERISTIC FieldOrientedController_HIL_cal_impl.OverloadOptions_maxOverload "" VALUE 0x002C0060 Scalar_ULONG 0 FieldOrientedController_HIL_CM_uint32 0 2147483646 /end CHARACTERISTIC
/begin CHARACTERISTIC FieldOrientedController_HIL_cal_impl.OverloadOptions_startupDur "" VALUE 0x002C0064 Scalar_ULONG 0 FieldOrientedController_HIL_CM_uint32 0 2147483646 /end CHARACTERISTIC
/begin CHARACTERISTIC FieldOrientedController_HIL_cal_impl.PWMCapture_P1 "" VALUE 0x002C0110 Scalar_FLOAT64_IEEE 0 FieldOrientedController_HIL_CM_double -1.7E+308 1.7E+308 /end CHARACTERISTIC
/begin CHARACTERISTIC FieldOrientedController_HIL_cal_impl.PWMCapture_P10 "" VALUE 0x002C01F8 Scalar_FLOAT64_IEEE 0 FieldOrientedController_HIL_CM_double -1.7E+308 1.7E+308 /end CHARACTERISTIC
/begin CHARACTERISTIC FieldOrientedController_HIL_cal_impl.PWMCapture_P11 "" VALUE 0x002C0210 Scalar_FLOAT64_IEEE 0 FieldOrientedController_HIL_CM_double -1.7E+308 1.7E+308 /end CHARACTERISTIC
/begin CHARACTERISTIC FieldOrientedController_HIL_cal_impl.PWMCapture_P12 "" VAL_BLK 0x002C0228 Scalar_FLOAT64_IEEE 0 FieldOrientedController_HIL_CM_double -1.7E+308 1.7E+308 MATRIX_DIM 3 1 /end CHARACTERISTIC
/begin CHARACTERISTIC FieldOrientedController_HIL_cal_impl.PWMCapture_P13 "" VAL_BLK 0x002C0250 Scalar_FLOAT64_IEEE 0 FieldOrientedController_HIL_CM_double -1.7E+308 1.7E+308 MATRIX_DIM 3 1 /end CHARACTERISTIC
/begin CHARACTERISTIC FieldOrientedController_HIL_cal_impl.PWMCapture_P14 "" VALUE 0x002C0278 Scalar_FLOAT64_IEEE 0 FieldOrientedController_HIL_CM_double -1.7E+308 1.7E+308 /end CHARACTERISTIC
/begin CHARACTERISTIC FieldOrientedController_HIL_cal_impl.PWMCapture_P15 "" VALUE 0x002C0290 Scalar_FLOAT64_IEEE 0 FieldOrientedController_HIL_CM_double -1.7E+308 1.7E+308 /end CHARACTERISTIC
/begin CHARACTERISTIC FieldOrientedController_HIL_cal_impl.PWMCapture_P2 "" VALUE 0x002C0128 Scalar_FLOAT64_IEEE 0 FieldOrientedController_HIL_CM_double -1.7E+308 1.7E+308 /end CHARACTERISTIC
/begin CHARACTERISTIC FieldOrientedController_HIL_cal_impl.PWMCapture_P3 "" VAL_BLK 0x002C0140 Scalar_FLOAT64_IEEE 0 FieldOrientedController_HIL_CM_double -1.7E+308 1.7E+308 MATRIX_DIM 3 1 /end CHARACTERISTIC
/begin CHARACTERISTIC FieldOrientedController_HIL_cal_impl.PWMCapture_P4 "" VALUE 0x002C0168 Scalar_FLOAT64_IEEE 0 FieldOrientedController_HIL_CM_double -1.7E+308 1.7E+308 /end CHARACTERISTIC
/begin CHARACTERISTIC FieldOrientedController_HIL_cal_impl.PWMCapture_P5 "" VALUE 0x002C0180 Scalar_FLOAT64_IEEE 0 FieldOrientedController_HIL_CM_double -1.7E+308 1.7E+308 /end CHARACTERISTIC
/begin CHARACTERISTIC FieldOrientedController_HIL_cal_impl.PWMCapture_P6 "" VALUE 0x002C0198 Scalar_FLOAT64_IEEE 0 FieldOrientedController_HIL_CM_double -1.7E+308 1.7E+308 /end CHARACTERISTIC
/begin CHARACTERISTIC FieldOrientedController_HIL_cal_impl.PWMCapture_P7 "" VALUE 0x002C01B0 Scalar_FLOAT64_IEEE 0 FieldOrientedController_HIL_CM_double -1.7E+308 1.7E+308 /end CHARACTERISTIC
/begin CHARACTERISTIC FieldOrientedController_HIL_cal_impl.PWMCapture_P8 "" VALUE 0x002C01C8 Scalar_FLOAT64_IEEE 0 FieldOrientedController_HIL_CM_double -1.7E+308 1.7E+308 /end CHARACTERISTIC
/begin CHARACTERISTIC FieldOrientedController_HIL_cal_impl.PWMCapture_P9 "" VALUE 0x002C01E0 Scalar_FLOAT64_IEEE 0 FieldOrientedController_HIL_CM_double -1.7E+308 1.7E+308 /end CHARACTERISTIC
/begin CHARACTERISTIC FieldOrientedController_HIL_cal_impl.QAE2_P1 "" VALUE 0x002C0470 Scalar_FLOAT64_IEEE 0 FieldOrientedController_HIL_CM_double -1.7E+308 1.7E+308 /end CHARACTERISTIC
/begin CHARACTERISTIC FieldOrientedController_HIL_cal_impl.QAE2_P10 "" VALUE 0x002C0548 Scalar_FLOAT64_IEEE 0 FieldOrientedController_HIL_CM_double -1.7E+308 1.7E+308 /end CHARACTERISTIC
/begin CHARACTERISTIC FieldOrientedController_HIL_cal_impl.QAE2_P11 "" VALUE 0x002C0560 Scalar_FLOAT64_IEEE 0 FieldOrientedController_HIL_CM_double -1.7E+308 1.7E+308 /end CHARACTERISTIC
/begin CHARACTERISTIC FieldOrientedController_HIL_cal_impl.QAE2_P12 "" VALUE 0x002C0578 Scalar_FLOAT64_IEEE 0 FieldOrientedController_HIL_CM_double -1.7E+308 1.7E+308 /end CHARACTERISTIC
/begin CHARACTERISTIC FieldOrientedController_HIL_cal_impl.QAE2_P13 "" VALUE 0x002C0590 Scalar_FLOAT64_IEEE 0 FieldOrientedController_HIL_CM_double -1.7E+308 1.7E+308 /end CHARACTERISTIC
/begin CHARACTERISTIC FieldOrientedController_HIL_cal_impl.QAE2_P14 "" VALUE 0x002C05A8 Scalar_FLOAT64_IEEE 0 FieldOrientedController_HIL_CM_double -1.7E+308 1.7E+308 /end CHARACTERISTIC
/begin CHARACTERISTIC FieldOrientedController_HIL_cal_impl.QAE2_P2 "" VALUE 0x002C0488 Scalar_FLOAT64_IEEE 0 FieldOrientedController_HIL_CM_double -1.7E+308 1.7E+308 /end CHARACTERISTIC
/begin CHARACTERISTIC FieldOrientedController_HIL_cal_impl.QAE2_P3 "" VALUE 0x002C04A0 Scalar_FLOAT64_IEEE 0 FieldOrientedController_HIL_CM_double -1.7E+308 1.7E+308 /end CHARACTERISTIC
/begin CHARACTERISTIC FieldOrientedController_HIL_cal_impl.QAE2_P4 "" VALUE 0x002C04B8 Scalar_FLOAT64_IEEE 0 FieldOrientedController_HIL_CM_double -1.7E+308 1.7E+308 /end CHARACTERISTIC
/begin CHARACTERISTIC FieldOrientedController_HIL_cal_impl.QAE2_P5 "" VALUE 0x002C04D0 Scalar_FLOAT64_IEEE 0 FieldOrientedController_HIL_CM_double -1.7E+308 1.7E+308 /end CHARACTERISTIC
/begin CHARACTERISTIC FieldOrientedController_HIL_cal_impl.QAE2_P6 "" VALUE 0x002C04E8 Scalar_FLOAT64_IEEE 0 FieldOrientedController_HIL_CM_double -1.7E+308 1.7E+308 /end CHARACTERISTIC
/begin CHARACTERISTIC FieldOrientedController_HIL_cal_impl.QAE2_P7 "" VALUE 0x002C0500 Scalar_FLOAT64_IEEE 0 FieldOrientedController_HIL_CM_double -1.7E+308 1.7E+308 /end CHARACTERISTIC
/begin CHARACTERISTIC FieldOrientedController_HIL_cal_impl.QAE2_P8 "" VALUE 0x002C0518 Scalar_FLOAT64_IEEE 0 FieldOrientedController_HIL_CM_double -1.7E+308 1.7E+308 /end CHARACTERISTIC
/begin CHARACTERISTIC FieldOrientedController_HIL_cal_impl.QAE2_P9 "" VALUE 0x002C0530 Scalar_FLOAT64_IEEE 0 FieldOrientedController_HIL_CM_double -1.7E+308 1.7E+308 /end CHARACTERISTIC
/begin CHARACTERISTIC FieldOrientedController_HIL_cal_impl.TorqueLoad_Value "" VALUE 0x002C0068 Scalar_FLOAT64_IEEE 0 FieldOrientedController_HIL_CM_double -1.7E+308 1.7E+308 /end CHARACTERISTIC
/begin CHARACTERISTIC FieldOrientedController_HIL_cal_impl.VelocityCommand_Value "" VALUE 0x002C0730 Scalar_FLOAT32_IEEE 0 FieldOrientedController_HIL_CM_single -3.4E+38 3.4E+38 /end CHARACTERISTIC
/begin CHARACTERISTIC FieldOrientedController_HIL_cal_impl.uDLookupTable_tableData "" CURVE 0x002C0738 Lookup1D_UBYTE 0 FieldOrientedController_HIL_CM_uint8 0 255
 /begin AXIS_DESCR COM_AXIS FieldOrientedController_HIL_B.velocityCommand FieldOrientedController_HIL_CM_single_rad_s 4 -3.4E+38 3.4E+38 AXIS_PTS_REF rtP_velCmdVec /end AXIS_DESCR
/end CHARACTERISTIC
/begin CHARACTERISTIC FieldOrientedController_HIL_cal_impl.velocityCommandmotorOn_P1 "" VALUE 0x002C02A8 Scalar_FLOAT64_IEEE 0 FieldOrientedController_HIL_CM_double -1.7E+308 1.7E+308 /end CHARACTERISTIC
/begin CHARACTERISTIC FieldOrientedController_HIL_cal_impl.velocityCommandmotorOn_P2 "" VALUE 0x002C02C0 Scalar_FLOAT64_IEEE 0 FieldOrientedController_HIL_CM_double -1.7E+308 1.7E+308 /end CHARACTERISTIC
/begin CHARACTERISTIC FieldOrientedController_HIL_cal_impl.velocityCommandmotorOn_P3 "" VAL_BLK 0x002C02D8 Scalar_FLOAT64_IEEE 0 FieldOrientedController_HIL_CM_double -1.7E+308 1.7E+308 MATRIX_DIM 3 1 /end CHARACTERISTIC
/begin CHARACTERISTIC FieldOrientedController_HIL_cal_impl.velocityCommandmotorOn_P4 "" VALUE 0x002C0300 Scalar_FLOAT64_IEEE 0 FieldOrientedController_HIL_CM_double -1.7E+308 1.7E+308 /end CHARACTERISTIC
/begin CHARACTERISTIC FieldOrientedController_HIL_cal_impl.velocityCommandmotorOn_P5 "" VAL_BLK 0x002C0318 Scalar_FLOAT64_IEEE 0 FieldOrientedController_HIL_CM_double -1.7E+308 1.7E+308 MATRIX_DIM 3 1 /end CHARACTERISTIC
/begin CHARACTERISTIC FieldOrientedController_HIL_cal_impl.velocityCommandmotorOn_P6 "" VAL_BLK 0x002C0340 Scalar_FLOAT64_IEEE 0 FieldOrientedController_HIL_CM_double -1.7E+308 1.7E+308 MATRIX_DIM 3 1 /end CHARACTERISTIC
/begin CHARACTERISTIC FieldOrientedController_HIL_cal_impl.velocityCommandmotorOn_P7 "" VALUE 0x002C0368 Scalar_FLOAT64_IEEE 0 FieldOrientedController_HIL_CM_double -1.7E+308 1.7E+308 /end CHARACTERISTIC
/begin CHARACTERISTIC FieldOrientedController_HIL_cal_impl.velocityCommandmotorOn_P8 "" VALUE 0x002C0380 Scalar_FLOAT64_IEEE 0 FieldOrientedController_HIL_CM_double -1.7E+308 1.7E+308 /end CHARACTERISTIC
/begin CHARACTERISTIC PMSM_Plant_Model_cal_impl.Bias1_Bias "" VALUE 0x002C09C8 Scalar_FLOAT64_IEEE 0 PMSM_Plant_Model_CM_double -1.7E+308 1.7E+308 /end CHARACTERISTIC
/begin CHARACTERISTIC PMSM_Plant_Model_cal_impl.Constant2_Value "" VALUE 0x002C09EA Scalar_UWORD 0 PMSM_Plant_Model_CM_uint16 0 65535 /end CHARACTERISTIC
/begin CHARACTERISTIC PMSM_Plant_Model_cal_impl.Constant_Value "" VALUE 0x002C09EC Scalar_UWORD 0 PMSM_Plant_Model_CM_uint16 0 65535 /end CHARACTERISTIC
/begin CHARACTERISTIC PMSM_Plant_Model_cal_impl.Count_Per_Radian_Gain "" VALUE 0x002C09E0 Scalar_FLOAT64_IEEE 0 PMSM_Plant_Model_CM_double -1.7E+308 1.7E+308 /end CHARACTERISTIC
/begin CHARACTERISTIC PMSM_Plant_Model_cal_impl.Encoder_Index_Position_Value "" VALUE 0x002C09A8 Scalar_FLOAT64_IEEE 0 PMSM_Plant_Model_CM_double -1.7E+308 1.7E+308 /end CHARACTERISTIC
/begin CHARACTERISTIC PMSM_Plant_Model_cal_impl.Gain1_Gain "" VALUE 0x002C09D0 Scalar_FLOAT64_IEEE 0 PMSM_Plant_Model_CM_double -1.7E+308 1.7E+308 /end CHARACTERISTIC
/begin CHARACTERISTIC PMSM_Plant_Model_cal_impl.Gain_Gain "" VALUE 0x002C09C0 Scalar_FLOAT64_IEEE 0 PMSM_Plant_Model_CM_double -1.7E+308 1.7E+308 /end CHARACTERISTIC
/begin CHARACTERISTIC PMSM_Plant_Model_cal_impl.Memory_InitialCondition "" VALUE 0x002C09EF Scalar_BOOLEAN 0 PMSM_Plant_Model_CM_logical 0 1 /end CHARACTERISTIC
/begin CHARACTERISTIC PMSM_Plant_Model_cal_impl.ModIndex_Gain "" VALUE 0x002C09E8 Scalar_UWORD 0 PMSM_Plant_Model_CM_ufix16_En26 0.0 0.00097655 /end CHARACTERISTIC
/begin CHARACTERISTIC PMSM_Plant_Model_cal_impl.Neg_Pi_Div_Two_Value "" VALUE 0x002C09B8 Scalar_FLOAT64_IEEE 0 PMSM_Plant_Model_CM_double -1.7E+308 1.7E+308 /end CHARACTERISTIC
/begin CHARACTERISTIC PMSM_Plant_Model_cal_impl.One_Value "" VALUE 0x002C09EE Scalar_BOOLEAN 0 PMSM_Plant_Model_CM_logical 0 1 /end CHARACTERISTIC
/begin CHARACTERISTIC PMSM_Plant_Model_cal_impl.Pi_Div_Two1_Value "" VALUE 0x002C09B0 Scalar_FLOAT64_IEEE 0 PMSM_Plant_Model_CM_double -1.7E+308 1.7E+308 /end CHARACTERISTIC
/begin CHARACTERISTIC PMSM_Plant_Model_cal_impl.Two_Pi_Value "" VALUE 0x002C09D8 Scalar_FLOAT64_IEEE 0 PMSM_Plant_Model_CM_double -1.7E+308 1.7E+308 /end CHARACTERISTIC
/begin CHARACTERISTIC PMSM_Plant_Model_cal_impl.Zero_Value "" VALUE 0x002C09A0 Scalar_FLOAT64_IEEE 0 PMSM_Plant_Model_CM_double -1.7E+308 1.7E+308 /end CHARACTERISTIC
/begin CHARACTERISTIC rtP_adcTransducerVoltAtZeroAmpere "" VAL_BLK 0x002C07D0 Scalar_FLOAT64_IEEE 0 FieldOrientedController_HIL_CM_double_V -1.7E+308 1.7E+308 MATRIX_DIM 2 1 /end CHARACTERISTIC
/begin CHARACTERISTIC rtP_adcTransducerVoltPerAmpere "" VALUE 0x002C07C0 Scalar_FLOAT64_IEEE 0 FieldOrientedController_HIL_CM_double_V_A -1.7E+308 1.7E+308 /end CHARACTERISTIC
/begin CHARACTERISTIC rtP_discInertia "" VALUE 0x002C07B8 Scalar_FLOAT64_IEEE 0 FieldOrientedController_HIL_CM_double_kg_m_m -1.7E+308 1.7E+308 /end CHARACTERISTIC
/begin CHARACTERISTIC rtP_encoderALeadsB "" VALUE 0x002C0781 Scalar_BOOLEAN 0 FieldOrientedController_HIL_CM_logical 0 1 /end CHARACTERISTIC
/begin CHARACTERISTIC rtP_encoderPositionValidAtStartup "" VALUE 0x002C0780 Scalar_BOOLEAN 0 FieldOrientedController_HIL_CM_logical 0 1 /end CHARACTERISTIC
/begin CHARACTERISTIC rtP_encoderRotorPositionAtIndex "" VALUE 0x002C07B0 Scalar_FLOAT64_IEEE 0 FieldOrientedController_HIL_CM_double_rad -1.7E+308 1.7E+308 /end CHARACTERISTIC
/begin CHARACTERISTIC rtP_pmsmPolePairs "" VALUE 0x002C07A8 Scalar_FLOAT64_IEEE 0 FieldOrientedController_HIL_CM_double_1 -1.7E+308 1.7E+308 /end CHARACTERISTIC
/begin CHARACTERISTIC rtP_pmsmRotorPositionInit "" VALUE 0x002CB508 Scalar_FLOAT64_IEEE 0 FieldOrientedController_HIL_CM_double_rad -1.7E+308 1.7E+308 /end CHARACTERISTIC
/begin CHARACTERISTIC rtP_pmsmRotorVelocityInit "" VALUE 0x002CB500 Scalar_FLOAT64_IEEE 0 FieldOrientedController_HIL_CM_double_rad_s -1.7E+308 1.7E+308 /end CHARACTERISTIC
/begin CHARACTERISTIC rtP_pwmCounterMax "" VALUE 0x002C07A0 Scalar_FLOAT64_IEEE 0 FieldOrientedController_HIL_CM_double_1 -1.7E+308 1.7E+308 /end CHARACTERISTIC
/begin MEASUREMENT FieldOrientedController_HIL_B.APmode "" FLOAT64_IEEE FieldOrientedController_HIL_CM_double 0 0 -1.7E+308 1.7E+308 ECU_ADDRESS 0x002CB080 /end MEASUREMENT
/begin MEASUREMENT FieldOrientedController_HIL_B.CastToBoolean "" UBYTE FieldOrientedController_HIL_CM_logical_1 0 0 0 1 ECU_ADDRESS 0x002CB161 /end MEASUREMENT
/begin MEASUREMENT FieldOrientedController_HIL_B.CastToDouble "" FLOAT64_IEEE FieldOrientedController_HIL_CM_double 0 0 -1.7E+308 1.7E+308 ECU_ADDRESS 0x002CB108 /end MEASUREMENT
/begin MEASUREMENT FieldOrientedController_HIL_B.CastToDouble1 "" FLOAT64_IEEE FieldOrientedController_HIL_CM_double 0 0 -1.7E+308 1.7E+308 ECU_ADDRESS 0x002CB110 /end MEASUREMENT
/begin MEASUREMENT FieldOrientedController_HIL_B.CastToDouble2 "" FLOAT64_IEEE FieldOrientedController_HIL_CM_double_1 0 0 -1.7E+308 1.7E+308 ECU_ADDRESS 0x002CB118 /end MEASUREMENT
/begin MEASUREMENT FieldOrientedController_HIL_B.CastToDouble3 "" FLOAT64_IEEE FieldOrientedController_HIL_CM_double_V 0 0 -1.7E+308 1.7E+308 LAYOUT COLUMN_DIR MATRIX_DIM 2 ECU_ADDRESS 0x002CB120 /end MEASUREMENT
/begin MEASUREMENT FieldOrientedController_HIL_B.ConnectCurrentSensor "" UBYTE FieldOrientedController_HIL_CM_logical_1 0 0 0 1 ECU_ADDRESS 0x002CB15F /end MEASUREMENT
/begin MEASUREMENT FieldOrientedController_HIL_B.DataTypeConversion "" SLONG FieldOrientedController_HIL_CM_commandTypeEnum_1 0 0 0 3 ECU_ADDRESS 0x002CB14C /end MEASUREMENT
/begin MEASUREMENT FieldOrientedController_HIL_B.Digitalinput "" FLOAT64_IEEE FieldOrientedController_HIL_CM_double_1 0 0 -1.7E+308 1.7E+308 ECU_ADDRESS 0x002CB090 /end MEASUREMENT
/begin MEASUREMENT FieldOrientedController_HIL_B.DutyCycle2PWMCompare "" UWORD FieldOrientedController_HIL_CM_uint16_1 0 0 0 65535 LAYOUT COLUMN_DIR MATRIX_DIM 3 ECU_ADDRESS 0x002CB150 /end MEASUREMENT
/begin MEASUREMENT FieldOrientedController_HIL_B.EngageMotorBrake "" UBYTE FieldOrientedController_HIL_CM_logical_1 0 0 0 1 ECU_ADDRESS 0x002CB160 /end MEASUREMENT
/begin MEASUREMENT FieldOrientedController_HIL_B.ExtractDesiredBits "" UBYTE FieldOrientedController_HIL_CM_ufix1_E1 0 0 0.0 2 ECU_ADDRESS 0x002CB15B /end MEASUREMENT
/begin MEASUREMENT FieldOrientedController_HIL_B.ExtractDesiredBits_d "" UBYTE FieldOrientedController_HIL_CM_ufix1 0 0 0.0 1 ECU_ADDRESS 0x002CB15D /end MEASUREMENT
/begin MEASUREMENT FieldOrientedController_HIL_B.ModifyScalingOnly "" UBYTE FieldOrientedController_HIL_CM_ufix1_E1 0 0 0.0 2 ECU_ADDRESS 0x002CB15C /end MEASUREMENT
/begin MEASUREMENT FieldOrientedController_HIL_B.ModifyScalingOnly_c "" UBYTE FieldOrientedController_HIL_CM_ufix1 0 0 0.0 1 ECU_ADDRESS 0x002CB15E /end MEASUREMENT
/begin MEASUREMENT FieldOrientedController_HIL_B.MotorStatus "" UBYTE FieldOrientedController_HIL_CM_logical_1 0 0 0 1 ECU_ADDRESS 0x002CB162 /end MEASUREMENT
/begin MEASUREMENT FieldOrientedController_HIL_B.OverloadOptionsCore "" ULONG FieldOrientedController_HIL_CM_uint32 0 0 0 2147483646 ECU_ADDRESS 0x002CB138 /end MEASUREMENT
/begin MEASUREMENT FieldOrientedController_HIL_B.PWMDuty "" FLOAT64_IEEE FieldOrientedController_HIL_CM_double 0 0 -1.7E+308 1.7E+308 LAYOUT COLUMN_DIR MATRIX_DIM 3 ECU_ADDRESS 0x002CB098 /end MEASUREMENT
/begin MEASUREMENT FieldOrientedController_HIL_B.TorqueLoad "" FLOAT64_IEEE FieldOrientedController_HIL_CM_double_N_m 0 0 -1.7E+308 1.7E+308 ECU_ADDRESS 0x002CB088 /end MEASUREMENT
/begin MEASUREMENT FieldOrientedController_HIL_B.UnitConversion "" FLOAT64_IEEE FieldOrientedController_HIL_CM_double_rpm 0 0 -1.7E+308 1.7E+308 ECU_ADDRESS 0x002CB130 /end MEASUREMENT
/begin MEASUREMENT FieldOrientedController_HIL_B.VelocityCommand "" FLOAT32_IEEE FieldOrientedController_HIL_CM_single_rad_sec 0 0 -3.4E+38 3.4E+38 ECU_ADDRESS 0x002CB144 /end MEASUREMENT
/begin MEASUREMENT FieldOrientedController_HIL_B.directCurrent "" FLOAT64_IEEE FieldOrientedController_HIL_CM_double_A 0 0 -1.7E+308 1.7E+308 ECU_ADDRESS 0x002CB0C8 /end MEASUREMENT
/begin MEASUREMENT FieldOrientedController_HIL_B.electricalPosition "" FLOAT64_IEEE FieldOrientedController_HIL_CM_double_rad 0 0 -1.7E+308 1.7E+308 ECU_ADDRESS 0x002CB0E8 /end MEASUREMENT
/begin MEASUREMENT FieldOrientedController_HIL_B.electricalVelocity "" FLOAT64_IEEE FieldOrientedController_HIL_CM_double_rad_sec 0 0 -1.7E+308 1.7E+308 ECU_ADDRESS 0x002CB0F8 /end MEASUREMENT
/begin MEASUREMENT FieldOrientedController_HIL_B.electromagneticTorque "" FLOAT64_IEEE FieldOrientedController_HIL_CM_double_N_m 0 0 -1.7E+308 1.7E+308 ECU_ADDRESS 0x002CB0D8 /end MEASUREMENT
/begin MEASUREMENT FieldOrientedController_HIL_B.encoderCount "" UWORD FieldOrientedController_HIL_CM_uint16_1 0 0 0 65535 ECU_ADDRESS 0x002CB158 /end MEASUREMENT
/begin MEASUREMENT FieldOrientedController_HIL_B.encoderIndexFound "" UWORD FieldOrientedController_HIL_CM_uint16_1 0 0 0 65535 ECU_ADDRESS 0x002CB156 /end MEASUREMENT
/begin MEASUREMENT FieldOrientedController_HIL_B.phaseCurrentA "" FLOAT64_IEEE FieldOrientedController_HIL_CM_double_A 0 0 -1.7E+308 1.7E+308 ECU_ADDRESS 0x002CB0B0 /end MEASUREMENT
/begin MEASUREMENT FieldOrientedController_HIL_B.phaseCurrentB "" FLOAT64_IEEE FieldOrientedController_HIL_CM_double_A 0 0 -1.7E+308 1.7E+308 ECU_ADDRESS 0x002CB0B8 /end MEASUREMENT
/begin MEASUREMENT FieldOrientedController_HIL_B.phaseCurrentC "" FLOAT64_IEEE FieldOrientedController_HIL_CM_double_A 0 0 -1.7E+308 1.7E+308 ECU_ADDRESS 0x002CB0C0 /end MEASUREMENT
/begin MEASUREMENT FieldOrientedController_HIL_B.quadratureCurrent "" FLOAT64_IEEE FieldOrientedController_HIL_CM_double_A 0 0 -1.7E+308 1.7E+308 ECU_ADDRESS 0x002CB0D0 /end MEASUREMENT
/begin MEASUREMENT FieldOrientedController_HIL_B.rotorPosition "" FLOAT64_IEEE FieldOrientedController_HIL_CM_double_rad 0 0 -1.7E+308 1.7E+308 ECU_ADDRESS 0x002CB0E0 /end MEASUREMENT
/begin MEASUREMENT FieldOrientedController_HIL_B.rotorVelocity "" FLOAT64_IEEE FieldOrientedController_HIL_CM_double_rad_sec 0 0 -1.7E+308 1.7E+308 ECU_ADDRESS 0x002CB0F0 /end MEASUREMENT
/begin MEASUREMENT FieldOrientedController_HIL_B.rotorVelocity_l "" FLOAT64_IEEE FieldOrientedController_HIL_CM_double_rad_sec 0 0 -1.7E+308 1.7E+308 ECU_ADDRESS 0x002CB100 /end MEASUREMENT
/begin MEASUREMENT FieldOrientedController_HIL_B.transducerVoltage "" FLOAT32_IEEE FieldOrientedController_HIL_CM_single_V 0 0 -3.4E+38 3.4E+38 LAYOUT COLUMN_DIR MATRIX_DIM 2 ECU_ADDRESS 0x002CB13C /end MEASUREMENT
/begin MEASUREMENT FieldOrientedController_HIL_B.uDLookupTable "" UBYTE FieldOrientedController_HIL_CM_uint8 0 0 0 255 ECU_ADDRESS 0x002CB15A /end MEASUREMENT
/begin MEASUREMENT FieldOrientedController_HIL_B.velocityCommand "" FLOAT32_IEEE FieldOrientedController_HIL_CM_single_rad_sec 0 0 -3.4E+38 3.4E+38 ECU_ADDRESS 0x002CB148 /end MEASUREMENT
/begin MEASUREMENT FieldOrientedController_HIL_U.controllerInputs_h.commandType "" SLONG FieldOrientedController_HIL_CM_commandTypeEnum 0 0 0 3 ECU_ADDRESS 0x002CAE94 /end MEASUREMENT
/begin MEASUREMENT FieldOrientedController_HIL_U.controllerInputs_h.motorOn "" UBYTE FieldOrientedController_HIL_CM_logical 0 0 0 1 ECU_ADDRESS 0x002CAE90 /end MEASUREMENT
/begin MEASUREMENT FieldOrientedController_HIL_U.controllerInputs_h.velocityCommand "" FLOAT32_IEEE FieldOrientedController_HIL_CM_single 0 0 -3.4E+38 3.4E+38 ECU_ADDRESS 0x002CAE98 /end MEASUREMENT
/begin MEASUREMENT FieldOrientedController_HIL_U.physicalInputs_f.connectCurrentSensor "" UBYTE FieldOrientedController_HIL_CM_logical 0 0 0 1 ECU_ADDRESS 0x002CAE88 /end MEASUREMENT
/begin MEASUREMENT FieldOrientedController_HIL_U.physicalInputs_f.motorBrake "" UBYTE FieldOrientedController_HIL_CM_logical 0 0 0 1 ECU_ADDRESS 0x002CAE89 /end MEASUREMENT
/begin MEASUREMENT FieldOrientedController_HIL_U.physicalInputs_f.torqueLoad "" FLOAT64_IEEE FieldOrientedController_HIL_CM_double 0 0 -1.7E+308 1.7E+308 ECU_ADDRESS 0x002CAE80 /end MEASUREMENT
/begin MEASUREMENT FieldOrientedController_HIL_Y.mode "" FLOAT64_IEEE FieldOrientedController_HIL_CM_double 0 0 -1.7E+308 1.7E+308 ECU_ADDRESS 0x002CAE60 /end MEASUREMENT
/begin MEASUREMENT FieldOrientedController_HIL_Y.rotorVelocity "" FLOAT64_IEEE FieldOrientedController_HIL_CM_double_rad_sec 0 0 -1.7E+308 1.7E+308 ECU_ADDRESS 0x002CAE68 /end MEASUREMENT
/begin MEASUREMENT PMSM_Plant_Model_B.Add "" FLOAT64_IEEE PMSM_Plant_Model_CM_double 0 0 -1.7E+308 1.7E+308 ECU_ADDRESS 0x002CC740 /end MEASUREMENT
/begin MEASUREMENT PMSM_Plant_Model_B.Bias1 "" FLOAT64_IEEE PMSM_Plant_Model_CM_double 0 0 -1.7E+308 1.7E+308 LAYOUT COLUMN_DIR MATRIX_DIM 3 ECU_ADDRESS 0x002CC438 /end MEASUREMENT
/begin MEASUREMENT PMSM_Plant_Model_B.CastToDouble "" FLOAT64_IEEE PMSM_Plant_Model_CM_double_1 0 0 -1.7E+308 1.7E+308 ECU_ADDRESS 0x002CC3A0 /end MEASUREMENT
/begin MEASUREMENT PMSM_Plant_Model_B.CastToDouble_b "" FLOAT64_IEEE PMSM_Plant_Model_CM_double_1 0 0 -1.7E+308 1.7E+308 LAYOUT COLUMN_DIR MATRIX_DIM 3 ECU_ADDRESS 0x002CC4F0 /end MEASUREMENT
/begin MEASUREMENT PMSM_Plant_Model_B.Count_Data_Type "" UWORD PMSM_Plant_Model_CM_uint16 0 0 0 65535 ECU_ADDRESS 0x002CC780 /end MEASUREMENT
/begin MEASUREMENT PMSM_Plant_Model_B.Count_Per_Radian "" FLOAT64_IEEE PMSM_Plant_Model_CM_double 0 0 -1.7E+308 1.7E+308 ECU_ADDRESS 0x002CC750 /end MEASUREMENT
/begin MEASUREMENT PMSM_Plant_Model_B.Gain "" FLOAT64_IEEE PMSM_Plant_Model_CM_double 0 0 -1.7E+308 1.7E+308 LAYOUT COLUMN_DIR MATRIX_DIM 3 ECU_ADDRESS 0x002CC420 /end MEASUREMENT
/begin MEASUREMENT PMSM_Plant_Model_B.Gain1 "" FLOAT64_IEEE PMSM_Plant_Model_CM_double 0 0 -1.7E+308 1.7E+308 LAYOUT COLUMN_DIR MATRIX_DIM 3 ECU_ADDRESS 0x002CC718 /end MEASUREMENT
/begin MEASUREMENT PMSM_Plant_Model_B.INPUT_1_1_1 "" FLOAT64_IEEE PMSM_Plant_Model_CM_double 0 0 -1.7E+308 1.7E+308 LAYOUT COLUMN_DIR MATRIX_DIM 4 ECU_ADDRESS 0x002CC3A8 /end MEASUREMENT
/begin MEASUREMENT PMSM_Plant_Model_B.INPUT_2_1_1 "" FLOAT64_IEEE PMSM_Plant_Model_CM_double 0 0 -1.7E+308 1.7E+308 LAYOUT COLUMN_DIR MATRIX_DIM 4 ECU_ADDRESS 0x002CC508 /end MEASUREMENT
/begin MEASUREMENT PMSM_Plant_Model_B.INPUT_2_1_2 "" FLOAT64_IEEE PMSM_Plant_Model_CM_double 0 0 -1.7E+308 1.7E+308 LAYOUT COLUMN_DIR MATRIX_DIM 4 ECU_ADDRESS 0x002CC528 /end MEASUREMENT
/begin MEASUREMENT PMSM_Plant_Model_B.INPUT_2_1_3 "" FLOAT64_IEEE PMSM_Plant_Model_CM_double 0 0 -1.7E+308 1.7E+308 LAYOUT COLUMN_DIR MATRIX_DIM 4 ECU_ADDRESS 0x002CC548 /end MEASUREMENT
/begin MEASUREMENT PMSM_Plant_Model_B.INPUT_3_1_1 "" FLOAT64_IEEE PMSM_Plant_Model_CM_double 0 0 -1.7E+308 1.7E+308 LAYOUT COLUMN_DIR MATRIX_DIM 4 ECU_ADDRESS 0x002CC400 /end MEASUREMENT
/begin MEASUREMENT PMSM_Plant_Model_B.INPUT_4_1_1 "" FLOAT64_IEEE PMSM_Plant_Model_CM_double 0 0 -1.7E+308 1.7E+308 LAYOUT COLUMN_DIR MATRIX_DIM 4 ECU_ADDRESS 0x002CC450 /end MEASUREMENT
/begin MEASUREMENT PMSM_Plant_Model_B.INPUT_5_1_1 "" FLOAT64_IEEE PMSM_Plant_Model_CM_double 0 0 -1.7E+308 1.7E+308 LAYOUT COLUMN_DIR MATRIX_DIM 4 ECU_ADDRESS 0x002CC470 /end MEASUREMENT
/begin MEASUREMENT PMSM_Plant_Model_B.INPUT_6_1_1 "" FLOAT64_IEEE PMSM_Plant_Model_CM_double 0 0 -1.7E+308 1.7E+308 LAYOUT COLUMN_DIR MATRIX_DIM 4 ECU_ADDRESS 0x002CC490 /end MEASUREMENT
/begin MEASUREMENT PMSM_Plant_Model_B.INPUT_7_1_1 "" FLOAT64_IEEE PMSM_Plant_Model_CM_double 0 0 -1.7E+308 1.7E+308 LAYOUT COLUMN_DIR MATRIX_DIM 4 ECU_ADDRESS 0x002CC4B0 /end MEASUREMENT
/begin MEASUREMENT PMSM_Plant_Model_B.INPUT_8_1_1 "" FLOAT64_IEEE PMSM_Plant_Model_CM_double 0 0 -1.7E+308 1.7E+308 LAYOUT COLUMN_DIR MATRIX_DIM 4 ECU_ADDRESS 0x002CC4D0 /end MEASUREMENT
/begin MEASUREMENT PMSM_Plant_Model_B.INPUT_9_1_1 "" FLOAT64_IEEE PMSM_Plant_Model_CM_double 0 0 -1.7E+308 1.7E+308 LAYOUT COLUMN_DIR MATRIX_DIM 4 ECU_ADDRESS 0x002CC3C8 /end MEASUREMENT
/begin MEASUREMENT PMSM_Plant_Model_B.Logical_OR "" UBYTE PMSM_Plant_Model_CM_logical_1 0 0 0 1 ECU_ADDRESS 0x002CC78C /end MEASUREMENT
/begin MEASUREMENT PMSM_Plant_Model_B.MathFunction "" UWORD PMSM_Plant_Model_CM_uint16 0 0 0 65535 ECU_ADDRESS 0x002CC782 /end MEASUREMENT
/begin MEASUREMENT PMSM_Plant_Model_B.Memory "" UBYTE PMSM_Plant_Model_CM_logical 0 0 0 1 ECU_ADDRESS 0x002CC78A /end MEASUREMENT
/begin MEASUREMENT PMSM_Plant_Model_B.Mod "" FLOAT64_IEEE PMSM_Plant_Model_CM_double 0 0 -1.7E+308 1.7E+308 ECU_ADDRESS 0x002CC748 /end MEASUREMENT
/begin MEASUREMENT PMSM_Plant_Model_B.ModIndex "" FLOAT64_IEEE PMSM_Plant_Model_CM_double 0 0 -1.7E+308 1.7E+308 LAYOUT COLUMN_DIR MATRIX_DIM 3 ECU_ADDRESS 0x002CC3E8 /end MEASUREMENT
/begin MEASUREMENT PMSM_Plant_Model_B.OUTPUT_1_0 "" FLOAT64_IEEE PMSM_Plant_Model_CM_double 0 0 -1.7E+308 1.7E+308 LAYOUT COLUMN_DIR MATRIX_DIM 6 ECU_ADDRESS 0x002CC6D0 /end MEASUREMENT
/begin MEASUREMENT PMSM_Plant_Model_B.Position_Difference "" FLOAT64_IEEE PMSM_Plant_Model_CM_double 0 0 -1.7E+308 1.7E+308 ECU_ADDRESS 0x002CC758 /end MEASUREMENT
/begin MEASUREMENT PMSM_Plant_Model_B.Product "" FLOAT64_IEEE PMSM_Plant_Model_CM_double 0 0 -1.7E+308 1.7E+308 LAYOUT COLUMN_DIR MATRIX_DIM 2 ECU_ADDRESS 0x002CC760 /end MEASUREMENT
/begin MEASUREMENT PMSM_Plant_Model_B.RTP_1 "" FLOAT64_IEEE PMSM_Plant_Model_CM_double 0 0 -1.7E+308 1.7E+308 ECU_ADDRESS 0x002CC568 /end MEASUREMENT
/begin MEASUREMENT PMSM_Plant_Model_B.STATE_1 "" FLOAT64_IEEE PMSM_Plant_Model_CM_double 0 0 -1.7E+308 1.7E+308 LAYOUT COLUMN_DIR MATRIX_DIM 44 ECU_ADDRESS 0x002CC570 /end MEASUREMENT
/begin MEASUREMENT PMSM_Plant_Model_B.Subtract1 "" UWORD PMSM_Plant_Model_CM_uint16 0 0 0 65535 ECU_ADDRESS 0x002CC786 /end MEASUREMENT
/begin MEASUREMENT PMSM_Plant_Model_B.Sum "" UWORD PMSM_Plant_Model_CM_uint16 0 0 0 65535 ECU_ADDRESS 0x002CC788 /end MEASUREMENT
/begin MEASUREMENT PMSM_Plant_Model_B.Switch "" UWORD PMSM_Plant_Model_CM_uint16_1 0 0 0 65535 ECU_ADDRESS 0x002CC784 /end MEASUREMENT
/begin MEASUREMENT PMSM_Plant_Model_B.Switch1 "" FLOAT64_IEEE PMSM_Plant_Model_CM_double 0 0 -1.7E+308 1.7E+308 ECU_ADDRESS 0x002CC738 /end MEASUREMENT
/begin MEASUREMENT PMSM_Plant_Model_B.Switch_o "" UBYTE PMSM_Plant_Model_CM_logical 0 0 0 1 ECU_ADDRESS 0x002CC78B /end MEASUREMENT
/begin MEASUREMENT PMSM_Plant_Model_B.currentGreaterThanIndex "" UBYTE PMSM_Plant_Model_CM_logical 0 0 0 1 ECU_ADDRESS 0x002CC794 /end MEASUREMENT
/begin MEASUREMENT PMSM_Plant_Model_B.currentLessThanIndex "" UBYTE PMSM_Plant_Model_CM_logical 0 0 0 1 ECU_ADDRESS 0x002CC78D /end MEASUREMENT
/begin MEASUREMENT PMSM_Plant_Model_B.d "" FLOAT64_IEEE PMSM_Plant_Model_CM_double 0 0 -1.7E+308 1.7E+308 ECU_ADDRESS 0x002CC700 /end MEASUREMENT
/begin MEASUREMENT PMSM_Plant_Model_B.enabled "" FLOAT64_IEEE PMSM_Plant_Model_CM_double 0 0 -1.7E+308 1.7E+308 LAYOUT COLUMN_DIR MATRIX_DIM 2 ECU_ADDRESS 0x002CC770 /end MEASUREMENT
/begin MEASUREMENT PMSM_Plant_Model_B.encoderPassedIndexPulse "" UBYTE PMSM_Plant_Model_CM_logical 0 0 0 1 ECU_ADDRESS 0x002CC799 /end MEASUREMENT
/begin MEASUREMENT PMSM_Plant_Model_B.notWrapped "" UBYTE PMSM_Plant_Model_CM_logical 0 0 0 1 ECU_ADDRESS 0x002CC796 /end MEASUREMENT
/begin MEASUREMENT PMSM_Plant_Model_B.passedNegativeDirection "" UBYTE PMSM_Plant_Model_CM_logical 0 0 0 1 ECU_ADDRESS 0x002CC797 /end MEASUREMENT
/begin MEASUREMENT PMSM_Plant_Model_B.passedPositiveDirection "" UBYTE PMSM_Plant_Model_CM_logical 0 0 0 1 ECU_ADDRESS 0x002CC798 /end MEASUREMENT
/begin MEASUREMENT PMSM_Plant_Model_B.previousGreaterThanIndex "" UBYTE PMSM_Plant_Model_CM_logical 0 0 0 1 ECU_ADDRESS 0x002CC793 /end MEASUREMENT
/begin MEASUREMENT PMSM_Plant_Model_B.previousLessThanIndex "" UBYTE PMSM_Plant_Model_CM_logical 0 0 0 1 ECU_ADDRESS 0x002CC791 /end MEASUREMENT
/begin MEASUREMENT PMSM_Plant_Model_B.previousPosition "" FLOAT64_IEEE PMSM_Plant_Model_CM_double 0 0 -1.7E+308 1.7E+308 ECU_ADDRESS 0x002CC730 /end MEASUREMENT
/begin MEASUREMENT PMSM_Plant_Model_B.q "" FLOAT64_IEEE PMSM_Plant_Model_CM_double 0 0 -1.7E+308 1.7E+308 ECU_ADDRESS 0x002CC708 /end MEASUREMENT
/begin MEASUREMENT PMSM_Plant_Model_B.u "" FLOAT64_IEEE PMSM_Plant_Model_CM_double 0 0 -1.7E+308 1.7E+308 ECU_ADDRESS 0x002CC710 /end MEASUREMENT
/begin MEASUREMENT PMSM_Plant_Model_B.wrapAroundIndexGreaterThanPi "" UBYTE PMSM_Plant_Model_CM_logical 0 0 0 1 ECU_ADDRESS 0x002CC792 /end MEASUREMENT
/begin MEASUREMENT PMSM_Plant_Model_B.wrapAroundIndexLessThanPi "" UBYTE PMSM_Plant_Model_CM_logical 0 0 0 1 ECU_ADDRESS 0x002CC795 /end MEASUREMENT
/begin MEASUREMENT PMSM_Plant_Model_B.wrapNegativeDirection "" UBYTE PMSM_Plant_Model_CM_logical 0 0 0 1 ECU_ADDRESS 0x002CC78E /end MEASUREMENT
/begin MEASUREMENT PMSM_Plant_Model_B.wrapPositiveDirection "" UBYTE PMSM_Plant_Model_CM_logical 0 0 0 1 ECU_ADDRESS 0x002CC78F /end MEASUREMENT
/begin MEASUREMENT PMSM_Plant_Model_B.wrapped "" UBYTE PMSM_Plant_Model_CM_logical 0 0 0 1 ECU_ADDRESS 0x002CC790 /end MEASUREMENT
/begin MEASUREMENT PMSM_Plant_Model_DW.INPUT_1_1_1_Discrete "" FLOAT64_IEEE PMSM_Plant_Model_CM_double 0 0 -1.7E+308 1.7E+308 LAYOUT COLUMN_DIR MATRIX_DIM 2 ECU_ADDRESS 0x002CC140 /end MEASUREMENT
/begin MEASUREMENT PMSM_Plant_Model_DW.INPUT_2_1_1_Discrete "" FLOAT64_IEEE PMSM_Plant_Model_CM_double 0 0 -1.7E+308 1.7E+308 LAYOUT COLUMN_DIR MATRIX_DIM 2 ECU_ADDRESS 0x002CC1C0 /end MEASUREMENT
/begin MEASUREMENT PMSM_Plant_Model_DW.INPUT_2_1_2_Discrete "" FLOAT64_IEEE PMSM_Plant_Model_CM_double 0 0 -1.7E+308 1.7E+308 LAYOUT COLUMN_DIR MATRIX_DIM 2 ECU_ADDRESS 0x002CC1D0 /end MEASUREMENT
/begin MEASUREMENT PMSM_Plant_Model_DW.INPUT_2_1_3_Discrete "" FLOAT64_IEEE PMSM_Plant_Model_CM_double 0 0 -1.7E+308 1.7E+308 LAYOUT COLUMN_DIR MATRIX_DIM 2 ECU_ADDRESS 0x002CC1E0 /end MEASUREMENT
/begin MEASUREMENT PMSM_Plant_Model_DW.INPUT_3_1_1_Discrete "" FLOAT64_IEEE PMSM_Plant_Model_CM_double 0 0 -1.7E+308 1.7E+308 LAYOUT COLUMN_DIR MATRIX_DIM 2 ECU_ADDRESS 0x002CC160 /end MEASUREMENT
/begin MEASUREMENT PMSM_Plant_Model_DW.INPUT_4_1_1_Discrete "" FLOAT64_IEEE PMSM_Plant_Model_CM_double 0 0 -1.7E+308 1.7E+308 LAYOUT COLUMN_DIR MATRIX_DIM 2 ECU_ADDRESS 0x002CC170 /end MEASUREMENT
/begin MEASUREMENT PMSM_Plant_Model_DW.INPUT_5_1_1_Discrete "" FLOAT64_IEEE PMSM_Plant_Model_CM_double 0 0 -1.7E+308 1.7E+308 LAYOUT COLUMN_DIR MATRIX_DIM 2 ECU_ADDRESS 0x002CC180 /end MEASUREMENT
/begin MEASUREMENT PMSM_Plant_Model_DW.INPUT_6_1_1_Discrete "" FLOAT64_IEEE PMSM_Plant_Model_CM_double 0 0 -1.7E+308 1.7E+308 LAYOUT COLUMN_DIR MATRIX_DIM 2 ECU_ADDRESS 0x002CC190 /end MEASUREMENT
/begin MEASUREMENT PMSM_Plant_Model_DW.INPUT_7_1_1_Discrete "" FLOAT64_IEEE PMSM_Plant_Model_CM_double 0 0 -1.7E+308 1.7E+308 LAYOUT COLUMN_DIR MATRIX_DIM 2 ECU_ADDRESS 0x002CC1A0 /end MEASUREMENT
/begin MEASUREMENT PMSM_Plant_Model_DW.INPUT_8_1_1_Discrete "" FLOAT64_IEEE PMSM_Plant_Model_CM_double 0 0 -1.7E+308 1.7E+308 LAYOUT COLUMN_DIR MATRIX_DIM 2 ECU_ADDRESS 0x002CC1B0 /end MEASUREMENT
/begin MEASUREMENT PMSM_Plant_Model_DW.INPUT_9_1_1_Discrete "" FLOAT64_IEEE PMSM_Plant_Model_CM_double 0 0 -1.7E+308 1.7E+308 LAYOUT COLUMN_DIR MATRIX_DIM 2 ECU_ADDRESS 0x002CC150 /end MEASUREMENT
/begin MEASUREMENT PMSM_Plant_Model_DW.Memory_PreviousInput "" FLOAT64_IEEE PMSM_Plant_Model_CM_double 0 0 -1.7E+308 1.7E+308 ECU_ADDRESS 0x002CC2E0 /end MEASUREMENT
/begin MEASUREMENT PMSM_Plant_Model_DW.Memory_PreviousInput_h "" UBYTE PMSM_Plant_Model_CM_logical 0 0 0 1 ECU_ADDRESS 0x002CC385 /end MEASUREMENT
/begin MEASUREMENT PMSM_Plant_Model_DW.OUTPUT_1_0_Discrete "" FLOAT64_IEEE PMSM_Plant_Model_CM_double 0 0 -1.7E+308 1.7E+308 ECU_ADDRESS 0x002CC2D8 /end MEASUREMENT
/begin MEASUREMENT PMSM_Plant_Model_DW.OUTPUT_1_0_FirstOutput "" UBYTE PMSM_Plant_Model_CM_logical 0 0 0 1 ECU_ADDRESS 0x002CC384 /end MEASUREMENT
/begin MEASUREMENT PMSM_Plant_Model_DW.OUTPUT_1_0_Modes "" SLONG PMSM_Plant_Model_CM_int_T 0 0 -2147483648 2147483647 ECU_ADDRESS 0x002CC37C /end MEASUREMENT
/begin MEASUREMENT PMSM_Plant_Model_DW.RTP_1_SetParametersNeeded "" UBYTE PMSM_Plant_Model_CM_logical 0 0 0 1 ECU_ADDRESS 0x002CC382 /end MEASUREMENT
/begin MEASUREMENT PMSM_Plant_Model_DW.STATE_1_Discrete "" FLOAT64_IEEE PMSM_Plant_Model_CM_double 0 0 -1.7E+308 1.7E+308 LAYOUT COLUMN_DIR MATRIX_DIM 29 ECU_ADDRESS 0x002CC1F0 /end MEASUREMENT
/begin MEASUREMENT PMSM_Plant_Model_DW.STATE_1_FirstOutput "" UBYTE PMSM_Plant_Model_CM_logical 0 0 0 1 ECU_ADDRESS 0x002CC383 /end MEASUREMENT
/begin MEASUREMENT PMSM_Plant_Model_DW.STATE_1_Modes "" SLONG PMSM_Plant_Model_CM_int_T 0 0 -2147483648 2147483647 LAYOUT COLUMN_DIR MATRIX_DIM 15 ECU_ADDRESS 0x002CC340 /end MEASUREMENT
/begin MEASUREMENT PMSM_Plant_Model_DW.Sum_DWORK1 "" UWORD PMSM_Plant_Model_CM_uint16 0 0 0 65535 ECU_ADDRESS 0x002CC380 /end MEASUREMENT
/begin AXIS_PTS rtP_velCmdVec "" 0x002C0790 FieldOrientedController_HIL_B.velocityCommand Axis_FLOAT32_IEEE 0 FieldOrientedController_HIL_CM_single_rad_s 4 -3.4E+38 3.4E+38 /end AXIS_PTS
/begin COMPU_METHOD FieldOrientedController_HIL_CM_commandTypeEnum "" TAB_VERB "%0.6" "" COMPU_TAB_REF VTAB_FOR_FieldOrientedController_HIL_CM_commandTypeEnum /end COMPU_METHOD
/begin COMPU_VTAB VTAB_FOR_FieldOrientedController_HIL_CM_commandTypeEnum "Enumerated data type: commandTypeEnum" TAB_VERB 4 0 "commandTypeEnum_Error" 1 "commandTypeEnum_OpenLoop" 2 "commandTypeEnum_CalibrateEncoder" 3 "commandTypeEnum_ClosedLoop" /end COMPU_VTAB
/begin COMPU_METHOD FieldOrientedController_HIL_CM_commandTypeEnum_1 "" TAB_VERB "%0.6" "1" COMPU_TAB_REF VTAB_FOR_FieldOrientedController_HIL_CM_commandTypeEnum_1 /end COMPU_METHOD
/begin COMPU_VTAB VTAB_FOR_FieldOrientedController_HIL_CM_commandTypeEnum_1 "Enumerated data type: commandTypeEnum" TAB_VERB 4 0 "commandTypeEnum_Error" 1 "commandTypeEnum_OpenLoop" 2 "commandTypeEnum_CalibrateEncoder" 3 "commandTypeEnum_ClosedLoop" /end COMPU_VTAB
/begin COMPU_METHOD FieldOrientedController_HIL_CM_double "" IDENTICAL "%15.10" "" /end COMPU_METHOD
/begin COMPU_METHOD FieldOrientedController_HIL_CM_double_1 "" IDENTICAL "%15.10" "1" /end COMPU_METHOD
/begin COMPU_METHOD FieldOrientedController_HIL_CM_double_A "" IDENTICAL "%15.10" "A" /end COMPU_METHOD
/begin COMPU_METHOD FieldOrientedController_HIL_CM_double_N_m "" IDENTICAL "%15.10" "N*m" /end COMPU_METHOD
/begin COMPU_METHOD FieldOrientedController_HIL_CM_double_V "" IDENTICAL "%15.10" "V" /end COMPU_METHOD
/begin COMPU_METHOD FieldOrientedController_HIL_CM_double_V_A "" IDENTICAL "%15.10" "V/A" /end COMPU_METHOD
/begin COMPU_METHOD FieldOrientedController_HIL_CM_double_kg_m_m "" IDENTICAL "%15.10" "kg*m*m" /end COMPU_METHOD
/begin COMPU_METHOD FieldOrientedController_HIL_CM_double_rad "" IDENTICAL "%15.10" "rad" /end COMPU_METHOD
/begin COMPU_METHOD FieldOrientedController_HIL_CM_double_rad_s "" IDENTICAL "%15.10" "rad/s" /end COMPU_METHOD
/begin COMPU_METHOD FieldOrientedController_HIL_CM_double_rad_sec "" IDENTICAL "%15.10" "rad/sec" /end COMPU_METHOD
/begin COMPU_METHOD FieldOrientedController_HIL_CM_double_rpm "" IDENTICAL "%15.10" "rpm" /end COMPU_METHOD
/begin COMPU_METHOD FieldOrientedController_HIL_CM_logical "" IDENTICAL "%1.0" "" /end COMPU_METHOD
/begin COMPU_METHOD FieldOrientedController_HIL_CM_logical_1 "" IDENTICAL "%1.0" "1" /end COMPU_METHOD
/begin COMPU_METHOD FieldOrientedController_HIL_CM_single "" IDENTICAL "%8.6" "" /end COMPU_METHOD
/begin COMPU_METHOD FieldOrientedController_HIL_CM_single_V "" IDENTICAL "%8.6" "V" /end COMPU_METHOD
/begin COMPU_METHOD FieldOrientedController_HIL_CM_single_rad_s "" IDENTICAL "%8.6" "rad/s" /end COMPU_METHOD
/begin COMPU_METHOD FieldOrientedController_HIL_CM_single_rad_sec "" IDENTICAL "%8.6" "rad/sec" /end COMPU_METHOD
/begin COMPU_METHOD FieldOrientedController_HIL_CM_ufix1 "" IDENTICAL "%0.6" "" /end COMPU_METHOD
/begin COMPU_METHOD FieldOrientedController_HIL_CM_ufix1_E1 "" LINEAR "%1.0" "" COEFFS_LINEAR 2.000000 0.000000 /end COMPU_METHOD
/begin COMPU_METHOD FieldOrientedController_HIL_CM_uint16_1 "" IDENTICAL "%5.0" "1" /end COMPU_METHOD
/begin COMPU_METHOD FieldOrientedController_HIL_CM_uint32 "" IDENTICAL "%10.0" "" /end COMPU_METHOD
/begin COMPU_METHOD FieldOrientedController_HIL_CM_uint8 "" IDENTICAL "%3.0" "" /end COMPU_METHOD
/begin COMPU_METHOD PMSM_Plant_Model_CM_double "" IDENTICAL "%15.10" "" /end COMPU_METHOD
/begin COMPU_METHOD PMSM_Plant_Model_CM_double_1 "" IDENTICAL "%15.10" "1" /end COMPU_METHOD
/begin COMPU_METHOD PMSM_Plant_Model_CM_int_T "" IDENTICAL "customformat" "" /end COMPU_METHOD
/begin COMPU_METHOD PMSM_Plant_Model_CM_logical "" IDENTICAL "%1.0" "" /end COMPU_METHOD
/begin COMPU_METHOD PMSM_Plant_Model_CM_logical_1 "" IDENTICAL "%1.0" "1" /end COMPU_METHOD
/begin COMPU_METHOD PMSM_Plant_Model_CM_ufix16_En26 "" LINEAR "%13.16" "" COEFFS_LINEAR 0.000000 0.000000 /end COMPU_METHOD
/begin COMPU_METHOD PMSM_Plant_Model_CM_uint16 "" IDENTICAL "%5.0" "" /end COMPU_METHOD
/begin COMPU_METHOD PMSM_Plant_Model_CM_uint16_1 "" IDENTICAL "%5.0" "1" /end COMPU_METHOD
/begin RECORD_LAYOUT Lookup1D_UBYTE FNC_VALUES 1 UBYTE COLUMN_DIR DIRECT /end RECORD_LAYOUT
/begin RECORD_LAYOUT Scalar_BOOLEAN FNC_VALUES 1 UBYTE COLUMN_DIR DIRECT /end RECORD_LAYOUT
/begin RECORD_LAYOUT Scalar_FLOAT32_IEEE FNC_VALUES 1 FLOAT32_IEEE COLUMN_DIR DIRECT /end RECORD_LAYOUT
/begin RECORD_LAYOUT Scalar_FLOAT64_IEEE FNC_VALUES 1 FLOAT64_IEEE COLUMN_DIR DIRECT /end RECORD_LAYOUT
/begin RECORD_LAYOUT Scalar_SLONG FNC_VALUES 1 SLONG COLUMN_DIR DIRECT /end RECORD_LAYOUT
/begin RECORD_LAYOUT Scalar_UBYTE FNC_VALUES 1 UBYTE COLUMN_DIR DIRECT /end RECORD_LAYOUT
/begin RECORD_LAYOUT Scalar_ULONG FNC_VALUES 1 ULONG COLUMN_DIR DIRECT /end RECORD_LAYOUT
/begin RECORD_LAYOUT Scalar_UWORD FNC_VALUES 1 UWORD COLUMN_DIR DIRECT /end RECORD_LAYOUT
/begin RECORD_LAYOUT Axis_FLOAT32_IEEE AXIS_PTS_X 1 FLOAT32_IEEE INDEX_INCR DIRECT /end RECORD_LAYOUT
/begin GROUP FieldOrientedController_HIL "FieldOrientedController_HIL" ROOT
 /begin REF_CHARACTERISTIC rtP_adcTransducerVoltAtZeroAmpere rtP_adcTransducerVoltPerAmpere rtP_discInertia rtP_encoderRotorPositionAtIndex rtP_pmsmPolePairs rtP_pmsmRotorPositionInit rtP_pmsmRotorVelocityInit rtP_pwmCounterMax rtP_encoderALeadsB rtP_encoderPositionValidAtStartup /end REF_CHARACTERISTIC
/end GROUP
/begin GROUP FieldOrientedController_HIL_U.controllerInputs_h ""
 /begin REF_MEASUREMENT FieldOrientedController_HIL_U.controllerInputs_h.motorOn FieldOrientedController_HIL_U.controllerInputs_h.commandType FieldOrientedController_HIL_U.controllerInputs_h.velocityCommand /end REF_MEASUREMENT
/end GROUP
/begin GROUP FieldOrientedController_HIL_U.physicalInputs_f ""
 /begin REF_MEASUREMENT FieldOrientedController_HIL_U.physicalInputs_f.torqueLoad FieldOrientedController_HIL_U.physicalInputs_f.connectCurrentSensor FieldOrientedController_HIL_U.physicalInputs_f.motorBrake /end REF_MEASUREMENT
/end GROUP
/begin GROUP PMSM_Plant_Model "PMSM_Plant_Model"
 /begin REF_CHARACTERISTIC PMSM_Plant_Model.rtP_adcTransducerVoltAtZeroAmpere PMSM_Plant_Model.rtP_adcTransducerVoltPerAmpere PMSM_Plant_Model.rtP_discInertia PMSM_Plant_Model.rtP_encoderRotorPositionAtIndex PMSM_Plant_Model.rtP_pmsmPolePairs PMSM_Plant_Model.rtP_pmsmRotorPositionInit PMSM_Plant_Model.rtP_pmsmRotorVelocityInit PMSM_Plant_Model.rtP_encoderALeadsB PMSM_Plant_Model.rtP_encoderPositionValidAtStartup /end REF_CHARACTERISTIC
 /begin REF_MEASUREMENT PMSM_Plant_Model.i_inputs_torqueLoad PMSM_Plant_Model.i_inputs_connectCurrentSensor PMSM_Plant_Model.i_inputs_motorBrake PMSM_Plant_Model.i_commands_inverterEnable PMSM_Plant_Model.i_commands_pwmCompare PMSM_Plant_Model.o_motorMeasurements_phaseCurrentA PMSM_Plant_Model.o_motorMeasurements_phaseCurrentB PMSM_Plant_Model.o_motorMeasurements_phaseCurrentC PMSM_Plant_Model.o_motorMeasurements_directCurrent PMSM_Plant_Model.o_motorMeasurements_quadratureCurrent PMSM_Plant_Model.o_motorMeasurements_electromagneticTorque PMSM_Plant_Model.o_motorMeasurements_rotorPosition PMSM_Plant_Model.o_motorMeasurements_electricalPosition PMSM_Plant_Model.o_motorMeasurements_rotorVelocity PMSM_Plant_Model.o_motorMeasurements_electricalVelocity PMSM_Plant_Model.o_feedback_transducerVoltage PMSM_Plant_Model.o_feedback_encoderIndexFound PMSM_Plant_Model.o_feedback_encoderCount /end REF_MEASUREMENT
/end GROUP
/end MODULE
/end PROJECT
